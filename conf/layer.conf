## conf/layer.conf
```bitbake
# We have a conf and classes directory, add to BBPATH
BBPATH .= ":${LAYERDIR}"

# We have recipes-* directories, add to BBFILES
BBFILES += "${LAYERDIR}/recipes-*/*/*.bb \
            ${LAYERDIR}/recipes-*/*/*.bbappend"

BBFILE_COLLECTIONS += "px4"
BBFILE_PATTERN_px4 = "^${LAYERDIR}/"
#BBFILE_PRIORITY_px4 = "5"
LAYERVERSION_px4 = "1"
```
